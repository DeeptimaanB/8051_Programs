;Write an 8051 assembly language program to display the message “VIT” on LCD display

ORG 0000H
	MOV A,#38H
	ACALL COMNWRT
	ACALL DELAY
	MOV A,#0EH
	ACALL COMNWRT
	ACALL DELAY
    MOV A,#01
	ACALL COMNWRT
	ACALL DELAY
    MOV A,#06H
	ACALL COMNWRT
	ACALL DELAY
	MOV A,#84H
	ACALL COMNWRT
	ACALL DELAY
	MOV A,#'V'
	ACALL DATAWRT
	ACALL DELAY
	MOV A,#'I'
	ACALL DATAWRT
	ACALL DELAY
	MOV A,#'T'
	ACALL DATAWRT
	AGAIN:SJMP AGAIN
COMNWRT:
MOV P2,A
CLR P3.7
CLR P3.6
SETB P3.5
ACALL DELAY
CLR P3.5
RET
DATAWRT:
MOV P2,A
SETB P3.7
CLR P3.6
SETB P3.5
ACALL DELAY
CLR P3.5
RET
DELAY:MOV R3,#50
HERE2:MOV R4,#255
HERE:DJNZ R4,HERE
DJNZ R3,HERE2
RET
END ;Deeptimaan Banerjee
