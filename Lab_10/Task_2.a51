;Write an 8051 assembly language program to display the message “VIT University” on LCD display using DPTR.

ORG 0000H
	MOV DPTR,#MYCOM
	C1: CLR A
	MOVC A,@A+DPTR
	ACALL COMNWRT
	ACALL DELAY
	INC DPTR
	JZ SEND_DAT
	SJMP C1
	SEND_DAT:
	MOV DPTR,#MYDATA
	D1: CLR A
	MOVC A,@A+DPTR
	ACALL DATAWRT
	ACALL DELAY
	INC DPTR
	JZ AGAIN
	SJMP D1
	AGAIN:SJMP AGAIN
COMNWRT:
MOV P2,A
CLR P3.7
CLR P3.6
SETB P3.5
ACALL DELAY
CLR P3.5
RET
DATAWRT:
MOV P2,A
SETB P3.7
CLR P3.6
SETB P3.5
ACALL DELAY
CLR P3.5
RET
DELAY:MOV R3,#250
HERE2:MOV R4,#255
HERE:DJNZ R4,HERE
DJNZ R3,HERE2
RET

ORG 300H
	MYCOM:DB 38H,0EH,01H,06H,80H,0
		MYDATA:DB "VIT UNIVERSITY",0
			END ;Deeptimaan Banerjee
