;Write an 8051 assembly language program to display the value typed in your computer keypad and display it on LCD via serial port. 

ORG 0000H
	
	MOV TMOD,#20H
	MOV TH1,#0FDH
	MOV SCON,#50H
	MOV A,#38H       ;INITIALIZE 2x16 LCD
	ACALL COMNWRT    ;CALL COMMAND SUBROUTINE
	ACALL DELAY      ;GIVE LCD SOME TIME
	MOV A,#0EH       ;DISPLAY ON,CURSOR ON
	ACALL COMNWRT
	ACALL DELAY
	MOV A,#01H       ;CLR LCD
	ACALL COMNWRT
	ACALL DELAY
	MOV A,#06H       ;SHIFT CURSOR RIGHT
	ACALL COMNWRT
	ACALL DELAY
	MOV A,#80H       ;CURSOR AT LINE 1,POS 4
	ACALL COMNWRT
	ACALL DELAY
	SETB TR1
	HERE: JNB RI,HERE   ; WAIT FOR THE LAST BIT
    MOV A,SBUF
	ACALL DATAWRT
	ACALL DELAY
   ; MOV P1,A	
	CLR RI              ;GET READY FOR NEXT BYTE
	SJMP HERE

COMNWRT: MOV P2,A   ;SEND COMMAND TO LCD
	CLR P3.7        ;RS=0 FOR COMMAND
	CLR P3.6        ;R/W=0 FOR WRITE 
	SETB P3.5       ;E=1 FOR HIGH PULSE
	ACALL DELAY
	CLR P3.5        ;E=0 FOR HIGH TO LOW PULSE
	RET
	
DATAWRT: MOV P2,A   ;SEND DATA TO LCD
	SETB P3.7       ;RS=1 FOR DATA
	CLR P3.6
	SETB P3.5
	ACALL DELAY
	CLR P3.5
	RET

DELAY: MOV R3,#50     ;50 OR HIGHER FOR FAST CPUs
HERE2: MOV R4,#255
HERE3: DJNZ R4, HERE3
      DJNZ R3,HERE2
	  RET
	  END ;Deeptimaan Banerjee
